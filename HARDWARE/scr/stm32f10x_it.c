/*-------------------------------------------------*/
/*            超纬电子STM32系列开发板              */
/*-------------------------------------------------*/
/*                                                 */
/*          实现各种中断服务函数的源文件           */
/*                                                 */
/*-------------------------------------------------*/

#include "stm32f10x.h"     //包含需要的头文件
#include "stm32f10x_it.h"  //包含需要的头文件
#include "delay.h"         //包含需要的头文件
#include "usart1.h"        //包含需要的头文件
#include "timer4.h"        //包含需要的头文件

/*-------------------------------------------------*/
/*函数名：串口1接收中断函数                        */
/*参  数：无                                       */
/*返回值：无                                       */
/*-------------------------------------------------*/
#if  USART1_RX_ENABLE          //如果使能了接收功能   
void USART1_IRQHandler(void)   
{
	if(USART_GetITStatus(USART1, USART_IT_RXNE) != RESET){            //如果USART_IT_RXNE标志置位，表示有数据到了，进入if分支
		Usart1_RxBuff[Usart1_RxCounter] = USART_ReceiveData(USART1);  //把接收到的数据保存到Usart1_RxBuff中		
		
		if(Usart1_RxCounter == 0){    //如果Usart1_RxCounter等于0，表示是接收的第1个数据，进入if分支
			TIM_Cmd(TIM4,ENABLE);     //开启定TIM4计时
		}else{                        //else分支，表示果Usart1_RxCounter不等于0，不是接收的第一个数据
			TIM_SetCounter(TIM4,0);   //清零TIM4计数器
	    }
	
		Usart1_RxCounter ++;        //每接收1个字节的数据，Usart1_RxCounter加1，表示接收的数据总量+1 
	}
} 
#endif

/*-------------------------------------------------*/
/*函数名：定时器4中断服务函数                      */
/*参  数：无                                       */
/*返回值：无                                       */
/*-------------------------------------------------*/
void TIM4_IRQHandler(void)
{
	if(TIM_GetITStatus(TIM4, TIM_IT_Update) != RESET){  //如果TIM_IT_Update置位，表示TIM4溢出中断，进入if	
		Usart1_RxCompleted = 1;                         //接收完成了，Usart1_RxCompleted设置为1	
		TIM_Cmd(TIM4, DISABLE);                         //关闭TIM4定时器
		TIM_ClearITPendingBit(TIM4, TIM_IT_Update);     //清除TIM4溢出中断标志 	
	}
}

/*-------------------------------------------------*/
/*函数名：不可屏蔽中断处理函数                     */
/*参  数：无                                       */
/*返回值：无                                       */
/*-------------------------------------------------*/
void NMI_Handler(void)
{

}

/*-------------------------------------------------*/
/*函数名：硬件出错后进入的中断处理函数             */
/*参  数：无                                       */
/*返回值：无                                       */
/*-------------------------------------------------*/
void HardFault_Handler(void)
{

}

/*-------------------------------------------------*/
/*函数名：内存管理中断处理函数                     */
/*参  数：无                                       */
/*返回值：无                                       */
/*-------------------------------------------------*/
void MemManage_Handler(void)
{

}

/*-------------------------------------------------*/
/*函数名：预取指失败，存储器访问失败中断处理函数   */
/*参  数：无                                       */
/*返回值：无                                       */
/*-------------------------------------------------*/
void BusFault_Handler(void)
{

}

/*-------------------------------------------------*/
/*函数名：未定义的指令或非法状态处理函数           */
/*参  数：无                                       */
/*返回值：无                                       */
/*-------------------------------------------------*/
void UsageFault_Handler(void)
{

}

/*-------------------------------------------------*/
/*函数名：软中断，SWI 指令调用的处理函数           */
/*参  数：无                                       */
/*返回值：无                                       */
/*-------------------------------------------------*/
void SVC_Handler(void)
{
	
}

/*-------------------------------------------------*/
/*函数名：调试监控器处理函数                       */
/*参  数：无                                       */
/*返回值：无                                       */
/*-------------------------------------------------*/
void DebugMon_Handler(void)
{
	
}

/*-------------------------------------------------*/
/*函数名：可挂起的系统服务处理函数                 */
/*参  数：无                                       */
/*返回值：无                                       */
/*-------------------------------------------------*/
void PendSV_Handler(void)
{
}

/*-------------------------------------------------*/
/*函数名：SysTic系统嘀嗒定时器处理函数             */
/*参  数：无                                       */
/*返回值：无                                       */
/*-------------------------------------------------*/
void SysTick_Handler(void)
{
 
}
